## CMakeLists.txt
```
cmake_minimum_required(VERSION 3.20.0)

find_package(Zephyr REQUIRED HINTS $ENV{ZEPHYR_BASE})
project(echoes)

set(CMAKE_EXPORT_COMPILE_COMMANDS ON)

file(GLOB app_sources src/*.c)
target_sources(app PRIVATE ${app_sources})
```

## prj.conf
```kconfig
CONFIG_SERIAL=y
CONFIG_UART_INTERRUPT_DRIVEN=y
CONFIG_RING_BUFFER=y

# Console & printk on UART0
CONFIG_CONSOLE=y
CONFIG_UART_CONSOLE=y
CONFIG_PRINTK=y
CONFIG_LOG=y
CONFIG_LOG_BACKEND_UART=y
CONFIG_LOG_DEFAULT_LEVEL=3
```

## boards/nrf9161.overlay
```dts
&uart0 {
  status = "okay";
  current-speed = <115200>;
}

&uart1 {
  status = "okay";
  current-speed = <115200>;
}

/ {
  chosen {
    zephyr,console = &uart0;
    zephyr,shell-uart = &uart0;
    zephyr,uart-mcumgr = &uart0;
  };
};
```

## src/main.c
```c
#include <stdint.h>
#include <zephyr/kernel.h>
#include <zephyr/logging/log.h>

#include "common.h"
#include "cta2045_pack.h"
#include "cta2045_resp.h"
#include "cta2045_types.h"
#include "cta2045_uart.h"

LOG_MODULE_REGISTER(app, LOG_LEVEL_INF);

#define CTA_THREAD_STACK_SIZE 4096
#define CTA_THREAD_PRIO 7

K_THREAD_STACK_DEFINE(cta_stack, CTA_THREAD_STACK_SIZE);
static struct k_thread cta_thr;

static void send_demo_frames(void) {
  uint8_t buf[64];
  size_t n;

  n = intermediate_pack_get_device_info_req(buf, sizeof(buf));
  if (n) {
    LOG_INF("Send Get Get Device Request");
    send_response(buf, n);
  }
}

void main(void) {
  LOG_INF("CTA-2045 demo starting…");

  if (cta2045_uart_init() != 0) {
    LOG_ERR("UART init failed");
    return;
  }

  k_thread_create(&cta_thr, cta_stack, K_THREAD_STACK_SIZEOF(cta_stack),
                  cta2045_uart_thread, NULL, NULL, NULL, CTA_THREAD_PRIO, 0,
                  K_NO_WAIT);

  send_demo_frames();

  while (1) {
    k_sleep(K_MSEC(10));
  }
}
```

## src/common.h
```c
#ifndef CTA2045_COMMON_H
#define CTA2045_COMMON_H

#include <stddef.h>
#include <stdint.h>

/* ---------- Build-time constants ---------- */
#ifndef RING_BUF_SIZE
#define RING_BUF_SIZE 1024
#endif

#ifndef TX_RING_BUF_SIZE
#define TX_RING_BUF_SIZE 1024
#endif

#ifndef MAX_PAYLOAD_LEN
#define MAX_PAYLOAD_LEN 4096
#endif

/* ---------- Utilities ---------- */
#ifndef ARRAY_SIZE
#define ARRAY_SIZE(x) (sizeof(x) / sizeof((x)[0]))
#endif

#ifndef MIN
#define MIN(a, b) ((a) < (b) ? (a) : (b))
#endif

#ifndef MAX
#define MAX(a, b) ((a) > (b) ? (a) : (b))
#endif

/* Generic raw message wrapper (optional helper) */
struct cta2045_msg {
  uint16_t length; /* big-endian on wire */
  uint8_t payload[MAX_PAYLOAD_LEN];
  uint16_t checksum; /* big-endian on wire */
};

#endif /* CTA2045_COMMON_H */
```

## src/cta2045_pack.c
```c
#include "cta2045_pack.h"
#include "cta2045_types.h"
#include "zephyr/sys/byteorder.h"
#include <stdint.h>

uint16_t checksum_calc(const uint8_t *buf, size_t len) {
  uint32_t c1 = 0xAA, c2 = 0;
  for (size_t i = 0; i < len; i++) {
    c1 = (c1 + buf[i]) % 0xFF;
    c2 = (c2 + c1) % 0xFF;
  }
  uint8_t hi = (uint8_t)(0xFF - ((c1 + c2) % 0xFF));
  uint8_t lo = (uint8_t)(0xFF - ((c1 + hi) % 0xFF));
  return (uint16_t)((hi << 8) | lo); // BE: HI first
}

size_t nak_pack(LinkLayerNakCode NakCode, uint8_t *out, size_t cap) {
  if (!out || cap < sizeof(struct LinkLayerMessage))
    return 0;

  struct LinkLayerMessage msg = {
      .msgType1 = LL_NAK_MSG_TYP1,
      .msgType2 = NakCode,
  };

  memcpy(out, &msg, sizeof(msg));
  return sizeof(msg);
}

size_t ack_pack(uint8_t *out, size_t cap) {
  if (!out || cap < sizeof(struct LinkLayerMessage))
    return 0;

  struct LinkLayerMessage msg = {
      .msgType1 = LL_ACK_MSG_TYP1,
      .msgType2 = LL_ACK_MSG_TYP2,
  };

  memcpy(out, &msg, sizeof(msg));
  return sizeof(msg);
}

size_t datalink_pack(uint8_t op1, uint8_t op2, uint8_t *out, size_t cap) {
  if (!out || cap < sizeof(struct DataLinkMessage))
    return 0;

  struct DataLinkMessage msg = {
      .msgType1 = DATALINK_MSG_TYP1,
      .msgType2 = DATALINK_MSG_TYP2,
      .length = sys_cpu_to_be16(2),
      .opCode1 = op1,
      .opCode2 = op2,
  };

  uint16_t cs =
      checksum_calc((const uint8_t *)&msg, sizeof(msg) - sizeof(msg.checksum));
  msg.checksum = sys_cpu_to_be16(cs);
  return sizeof(msg);
}

size_t basic_pack(uint8_t op1, uint8_t op2, uint8_t *out, size_t cap) {
  if (!out || cap < sizeof(struct BasicMessage))
    return 0;

  struct BasicMessage msg = {
      .msgType1 = BASIC_MSG_TYP1,
      .msgType2 = BASIC_MSG_TYP2,
      .length = sys_cpu_to_be16(2),
      .opCode1 = op1,
      .opCode2 = op2,
  };
  uint16_t cs =
      checksum_calc((const uint8_t *)&msg, sizeof(msg) - sizeof(msg.checksum));
  msg.checksum = sys_cpu_to_be16(cs);

  memcpy(out, &msg, sizeof(msg));
  return sizeof(msg);
}

size_t intermediate_pack_get_info_req(uint8_t *out, size_t cap) {
  if (!out || cap < sizeof(struct IntermediateMessage))
    return 0;

  struct IntermediateMessage msg = {
      .msgType1 = INTERMEDIATE_MSG_TYP1,
      .msgType2 = INTERMEDIATE_MSG_TYP2,
      .length = sys_cpu_to_be16(2),
      .opCode1 = GET_INFO_OP_CODE1,
      .opCode2 = GET_INFO_OP_CODE2,
  };
  uint16_t cs =
      checksum_calc((const uint8_t *)&msg, sizeof(msg) - sizeof(msg.checksum));
  msg.checksum = sys_cpu_to_be16(cs);

  memcpy(out, &msg, sizeof(msg));
  return sizeof(msg);
}

size_t intermediate_pack_get_utc_time_req(uint8_t *out, size_t cap) {
  if (!out || cap < sizeof(struct IntermediateMessage))
    return 0;

  struct IntermediateMessage msg = {
      .msgType1 = INTERMEDIATE_MSG_TYP1,
      .msgType2 = INTERMEDIATE_MSG_TYP2,
      .length = sys_cpu_to_be16(2),
      .opCode1 = GET_UTC_TIME,
      .opCode2 = 0x00,
  };
  uint16_t cs =
      checksum_calc((const uint8_t *)&msg, sizeof(msg) - sizeof(msg.checksum));
  msg.checksum = sys_cpu_to_be16(cs);

  memcpy(out, &msg, sizeof(msg));
  return sizeof(msg);
}

size_t datalink_pack_maxPayload_resp(uint8_t *out, size_t cap) {
  if (!out || cap < sizeof(struct DataLinkMessage))
    return 0;

  struct DataLinkMessage msg = {
      .msgType1 = DATALINK_MSG_TYP1,
      .msgType2 = DATALINK_MSG_TYP2,
      .length = sys_cpu_to_be16(2),
      .opCode1 = MAXPAYLOAD_RESP,
      .opCode2 = 0,
  };

  uint16_t cs =
      checksum_calc((const uint8_t *)&msg, sizeof(msg) - sizeof(msg.checksum));
  msg.checksum = sys_cpu_to_be16(cs);

  memcpy(out, &msg, sizeof(msg));
  return sizeof(msg);
}

size_t intermediate_pack_get_device_info_req(uint8_t *out, size_t cap) {
  if (!out || cap < sizeof(struct IntermediateMessage))
    return 0;

  struct IntermediateMessage msg = {
      .msgType1 = INTERMEDIATE_MSG_TYP1,
      .msgType2 = INTERMEDIATE_MSG_TYP2,
      .length = sys_cpu_to_be16(2),
      .opCode1 = 0x01,
      .opCode2 = 0x01,
  };

  uint16_t cs =
      checksum_calc((const uint8_t *)&msg, sizeof(msg) - sizeof(msg.checksum));
  msg.checksum = sys_cpu_to_be16(cs);

  memcpy(out, &msg, sizeof(msg));
  return sizeof(msg);
}

size_t intermediate_pack_get_utc_time_resp(uint8_t *out, size_t cap) {
  if (!out || cap < sizeof(struct GetUTCTimeResponse))
    return 0;
  struct GetUTCTimeResponse msg = {
      .msgType1 = INTERMEDIATE_MSG_TYP1,
      .msgType2 = INTERMEDIATE_MSG_TYP2,
      .length = sys_be16_to_cpu(sizeof(struct GetUTCTimeResponse) - 6),
      .opCode1 = GET_UTC_TIME,
      .opCode2 = OP_CODE2_REPLY,
      .responseCode = OP_CODE2_REPLY,
      .utcSeconds = 0,
      .timezoneOffsetQuarterHours = 0,
      .dstOffsetQuarterHours = 0,
  };

  uint16_t cs =
      checksum_calc((const uint8_t *)&msg, sizeof(msg) - sizeof(msg.checksum));
  msg.checksum = sys_cpu_to_be16(cs);

  memcpy(out, &msg, sizeof(msg));
  return sizeof(msg);
}
```

## src/cta2045_pack.h
```c
#ifndef CTA2045_PACK_H
#define CTA2045_PACK_H

#include "common.h"
#include "cta2045_types.h"
#include <stddef.h>
#include <stdint.h>

/* Returns bytes written (0 on error). */
uint16_t checksum_calc(const uint8_t *buf, size_t len);

size_t ack_pack(uint8_t *out, size_t cap);
size_t nak_pack(LinkLayerNakCode NakCode, uint8_t *out, size_t cap);

size_t basic_pack(uint8_t op1, uint8_t op2, uint8_t *out, size_t out_cap);
size_t datalink_pack(uint8_t op1, uint8_t op2, uint8_t *out, size_t out_cap);

size_t intermediate_pack_get_device_info_req(uint8_t *out, size_t cap);
size_t intermediate_pack_get_info_req(uint8_t *out, size_t cap);
size_t intermediate_pack_get_utc_time_req(uint8_t *out, size_t out_cap);

size_t datalink_pack_maxPayload_resp(uint8_t *out, size_t cap);
size_t intermediate_pack_get_utc_time_resp(uint8_t *out, size_t cap);

#endif /* CTA2045_PACK_H */
```

## src/cta2045_resp.c
```c
#include "cta2045_resp.h"
#include "cta2045_pack.h"
#include "cta2045_types.h"
#include "cta2045_uart.h"
#include <stddef.h>
#include <stdint.h>
#include <stdio.h>
#include <zephyr/logging/log.h>
#include <zephyr/sys/byteorder.h>

LOG_MODULE_REGISTER(cta2045, LOG_LEVEL_INF);

void process_response(struct MessageHeader *msg_header) {
  uint8_t buf[64];
  size_t n;
  if (msg_header->msgType1 == BASIC_MSG_TYP1 &&
      msg_header->msgType2 == BASIC_MSG_TYP2) {
    printf("Basic");
    struct BasicMessage *basic = (struct BasicMessage *)msg_header;
    process_basic_message(basic);
  } else if (msg_header->msgType1 == DATALINK_MSG_TYP1 &&
             msg_header->msgType2 == DATALINK_MSG_TYP2) {
    printf("Datalink");
    struct DataLinkMessage *datalink = (struct DataLinkMessage *)msg_header;
    process_datalink_message(datalink);
  } else if (msg_header->msgType1 == INTERMEDIATE_MSG_TYP1 &&
             msg_header->msgType2 == INTERMEDIATE_MSG_TYP2) {
    printf("Intermediate");
    struct IntermediateMessage *intermediate =
        (struct IntermediateMessage *)msg_header;
    process_intermediate_message(intermediate);
  } else {
    n = nak_pack(LLN_REQUEST_NOT_SUPPORTED, buf, sizeof(buf));
    if (n) {
      send_response(buf, sizeof(buf));
    }
  }
}

void process_basic_message(struct BasicMessage *msg) {
  uint8_t buf[64];
  size_t n;
  switch (msg->opCode1) {

  case APP_ACK:
    printf("\tAPP ACK\n");
    n = ack_pack(buf, sizeof(buf));
    if (n) {
      send_response(buf, n);
    }
    break;

  case APP_NAK:
    printf("\tAPP NAK Error Code: 0x%02X\n", msg->opCode2);
    n = ack_pack(buf, sizeof(buf));
    if (n) {
      send_response(buf, n);
    }
    break;

  case OPER_STATE_RESP:
    printf("\tOperational State Response\n");
    n = ack_pack(buf, sizeof(buf));
    if (n) {
      send_response(buf, n);
    }
    break;

  case CUST_OVERRIDE:
    printf("\tCustomer Override\n");
    n = ack_pack(buf, sizeof(buf));

    if (n) {
      send_response(buf, n);
    }

    n = basic_pack(APP_ACK, CUST_OVERRIDE, buf, sizeof(buf));

    if (n) {
      send_response(buf, n);
    }

    break;

  default:
    n = nak_pack(LLN_UNSUPPORTED_MESSAGE_TYPE, buf, sizeof(buf));
    if (n) {
      send_response(buf, n);
    }
    break;
  }
}

void process_datalink_message(struct DataLinkMessage *msg) {
  DataLinkTypeCode messageType = ConvertDataLinkType(msg->opCode1);

  uint8_t buf[64];
  size_t n;

  switch (messageType) {

  case DLT_MAX_PAYLOAD_REQUEST:
    printf("\tMaximum payload length?\n");
    n = ack_pack(buf, sizeof(buf));
    if (n) {
      send_response(buf, n);
    }

    n = datalink_pack(MAXPAYLOAD_REQ_OP_CODE1, CLEAR_OP_CODE2, buf,
                      sizeof(buf));
    if (n) {
      send_response(buf, n);
    }

    break;
  case DLT_MAX_PAYLOAD_RESPONSE:
    printf("\tMaximum payload length\n");
    n = ack_pack(buf, sizeof(buf));
    if (n) {
      send_response(buf, n);
    }
    break;
  default:
    printf("\tRequest Not Support\n");
    n = nak_pack(LLN_REQUEST_NOT_SUPPORTED, buf, sizeof(buf));
    if (n) {
      send_response(buf, n);
    }
    break;
  }
}

void process_get_device_info_response(struct IntermediateMessage *resp) {
  struct GetInfoResponse *msg = (struct GetInfoResponse *)resp;
  LOG_INF("=== GetInfoResponse ===");
  LOG_INF("msgType1=0x%02X  msgType2=0x%02X  length=%u", msg->msgType1,
          msg->msgType2, sys_be16_to_cpu(msg->length));
  LOG_INF("opCode1=0x%02X  opCode2=0x%02X  responseCode=0x%02X", msg->opCode1,
          msg->opCode2, msg->responseCode);
  LOG_INF("version=\"%.*s\"  vendorId=0x%04X  deviceType=0x%04X  "
          "revision=%02X %02X",
          2, msg->version, sys_be16_to_cpu(msg->vendorId),
          sys_be16_to_cpu(msg->deviceType), msg->deviceRevision[0],
          msg->deviceRevision[1]);
  LOG_INF("capability=%02X %02X %02X %02X  reserved=0x%02X", msg->capability[0],
          msg->capability[1], msg->capability[2], msg->capability[3],
          msg->reserved);
  LOG_INF("modelNumber=\"%.*s\"", 16, msg->modelNumber);
  LOG_INF("serialNumber=\"%.*s\"", 16, msg->serialNumber);
  LOG_INF("firmware=20%02u-%02u-%02u  fwVersion=%u.%u", msg->firmwareYear20xx,
          msg->firmwareMonth, msg->firmwareDay, msg->firmwareMajor,
          msg->firmwareMinor);
  LOG_INF("checksum=0x%04X", sys_be16_to_cpu(msg->checksum));
  LOG_INF("=======================");
}

void process_commodity_response(struct IntermediateMessage *resp) {
  struct CommodityResponse *msg = (struct CommodityResponse *)resp;
}

void process_set_temperature_offset_response(struct IntermediateMessage *resp) {
}

void process_get_temperature_offset_response(struct IntermediateMessage *resp) {
  struct GetTemperatureOffsetResponse *msg =
      (struct GetTemperatureOffsetResponse *)resp;
}

void process_intermediate_message(struct IntermediateMessage *msg) {
  uint16_t IntermediateType = *((uint16_t *)(&(msg->opCode1)));
  IntermediateTypeCode messageType = ConvertIntermediateType(IntermediateType);

  uint16_t len = msg->length;

  uint8_t buf[64];
  size_t n;
  switch (messageType) {
  case IT_INFO_RESPONSE:
    printf("\tGetInformation() - Reply\n");

    process_get_device_info_response(msg);

    n = ack_pack(buf, sizeof(buf));
    if (n) {
      send_response(buf, n);
    }
    break;

  case IT_GET_UTC_TIME_REQUEST:
    if (sys_cpu_to_be16(len) == 2) {
      n = ack_pack(buf, sizeof(buf));
      if (n) {
        send_response(buf, n);
      }
      struct GetUTCTimeResponse resp;

      n = intermediate_pack_get_utc_time_resp(buf, sizeof(buf));
      if (n) {
        send_response((uint8_t *)&resp, sizeof(resp));
      }
    } else {
      n = nak_pack(LLN_REQUEST_NOT_SUPPORTED, buf, sizeof(buf));
      if (n) {
        send_response(buf, n);
      }
    }
    break;

  case IT_COMMODITY_RESPONSE:
    printf("\tCommodity response\n");

    process_commodity_response(msg);

    n = ack_pack(buf, sizeof(buf));
    if (n) {
      send_response(buf, n);
    }
    break;

  case IT_SET_ENERGY_PRICE_RESPONSE:
    printf("\tSet Energy Price Response\n");
    n = ack_pack(buf, sizeof(buf));
    if (n) {
      send_response(buf, n);
    }
    break;

  case IT_GET_SET_TEMPERATURE_OFFSET_RESPONSE:
    len = sys_be16_to_cpu(len);
    size_t wire_bytes = (size_t)len + 6;

    if (wire_bytes == sizeof(struct IntermediateMessage)) {
      process_set_temperature_offset_response(msg);
    } else if (wire_bytes == sizeof(struct GetTemperatureOffsetResponse)) {
      process_get_temperature_offset_response(msg);
    } else {
    }
    n = ack_pack(buf, sizeof(buf));
    if (n) {
      send_response(buf, n);
    }
    break;

  case IT_GET_SET_SETPOINT_RESPONSE:
    n = ack_pack(buf, sizeof(buf));
    if (n) {
      send_response(buf, n);
    }
    break;

  case IT_GET_PRESENT_TEMPERATURE_RESPONSE:
    n = ack_pack(buf, sizeof(buf));
    if (n) {
      send_response(buf, n);
    }
    break;

  case IT_START_CYCLING_RESPONSE:
    n = ack_pack(buf, sizeof(buf));
    if (n) {
      send_response(buf, n);
    }
    break;

  case IT_TERMINATE_CYCLING_RESPONSE:
    n = ack_pack(buf, sizeof(buf));
    if (n) {
      send_response(buf, n);
    }
    break;

  default:
    n = nak_pack(LLN_REQUEST_NOT_SUPPORTED, buf, sizeof(buf));
    if (n) {
      send_response(buf, n);
    }
    break;
  }
}

IntermediateTypeCode ConvertIntermediateType(uint16_t intermediateType) {
  uint16_t host = sys_be16_to_cpu(intermediateType);
  switch (host) {
  case IT_INFO_REQUEST:
    return IT_INFO_REQUEST;
  case IT_INFO_RESPONSE:
    return IT_INFO_RESPONSE;
  case IT_GET_UTC_TIME_REQUEST:
    return IT_GET_UTC_TIME_REQUEST;
  case IT_COMMODITY_REQUEST:
    return IT_COMMODITY_REQUEST;
  case IT_COMMODITY_RESPONSE:
    return IT_COMMODITY_RESPONSE;
  case IT_SET_ENERGY_PRICE_RESPONSE:
    return IT_SET_ENERGY_PRICE_RESPONSE;
  case IT_GET_SET_TEMPERATURE_OFFSET_REQUEST:
    return IT_GET_SET_TEMPERATURE_OFFSET_REQUEST;
  case IT_GET_SET_TEMPERATURE_OFFSET_RESPONSE:
    return IT_GET_SET_TEMPERATURE_OFFSET_RESPONSE;
  case IT_GET_SET_SETPOINT_RESPONSE:
    return IT_GET_SET_SETPOINT_RESPONSE;
  case IT_GET_PRESENT_TEMPERATURE_RESPONSE:
    return IT_GET_PRESENT_TEMPERATURE_RESPONSE;
  case IT_START_CYCLING_RESPONSE:
    return IT_START_CYCLING_RESPONSE;
  case IT_TERMINATE_CYCLING_RESPONSE:
    return IT_TERMINATE_CYCLING_RESPONSE;
  default:
    return IT_INVALID;
  }
}

DataLinkTypeCode ConvertDataLinkType(uint8_t datalinkType) {
  switch (datalinkType) {
  case DLT_MAX_PAYLOAD_REQUEST:
    return DLT_MAX_PAYLOAD_REQUEST;
  case DLT_MAX_PAYLOAD_RESPONSE:
    return DLT_MAX_PAYLOAD_RESPONSE;
  case DLT_SEND_NEXT_COMMAND_TO_SLOT:
    return DLT_SEND_NEXT_COMMAND_TO_SLOT;
  default:
    return DLT_INVALID;
  }
}
```

## src/cta2045_resp.h
```c
#include "cta2045_pack.h"
#include "cta2045_types.h"

void process_response(struct MessageHeader *msg);

void process_basic_message(struct BasicMessage *msg);
void process_datalink_message(struct DataLinkMessage *msg);
void process_intermediate_message(struct IntermediateMessage *msg);

void process_get_device_info_response(struct IntermediateMessage *resp);
void process_commodity_response(struct IntermediateMessage *resp);
void process_set_temperature_offset_response(struct IntermediateMessage *resp);
void process_get_temperature_offset_response(struct IntermediateMessage *resp);

IntermediateTypeCode ConvertIntermediateType(uint16_t intermediateType);
DataLinkTypeCode ConvertDataLinkType(uint8_t datalinkType);
```

## src/cta2045_types.h
```c
#ifndef CTA2045_TYPES_H
#define CTA2045_TYPES_H

#include "common.h"
#include <stdint.h>

/* ---------- Message type bytes ---------- */
#define BASIC_MSG_TYP1 0x08
#define BASIC_MSG_TYP2 0x01

#define DATALINK_MSG_TYP1 0x08
#define DATALINK_MSG_TYP2 0x03

#define INTERMEDIATE_MSG_TYP1 0x08
#define INTERMEDIATE_MSG_TYP2 0x02

#define LL_ACK_MSG_TYP1 0x06
#define LL_ACK_MSG_TYP2 0x00

#define LL_NAK_MSG_TYP1 0x15

// Basic
#define APP_ACK 0x03
#define APP_NAK 0x04
#define OPER_STATE_REQ 0x12
#define OPER_STATE_RESP 0x13
#define CUST_OVERRIDE 0x11

// Data Link
#define MAXPAYLOAD_REQ_OP_CODE1 0x18
#define CLEAR_OP_CODE2 0x00
#define MAXPAYLOAD_RESP 0x19

// Intermediate
#define GET_INFO_OP_CODE1 0x01
#define GET_INFO_OP_CODE2 0x01

#define GET_UTC_TIME 0x02
#define OP_CODE2_REPLY 0x80

struct MessageHeader {
  uint8_t msgType1;
  uint8_t msgType2;
} __attribute__((packed));

struct LinkLayerMessage {
  uint8_t msgType1;
  uint8_t msgType2;
} __attribute__((packed));

struct BasicMessage {
  uint8_t msgType1;
  uint8_t msgType2;
  uint16_t length;
  uint8_t opCode1;
  uint8_t opCode2;
  uint16_t checksum;
} __attribute__((packed));

struct DataLinkMessage {
  uint8_t msgType1;
  uint8_t msgType2;
  uint16_t length;
  uint8_t opCode1;
  uint8_t opCode2;
  uint16_t checksum;
} __attribute__((packed));

struct IntermediateMessage {
  uint8_t msgType1;
  uint8_t msgType2;
  uint16_t length;
  uint8_t opCode1;
  uint8_t opCode2;
  uint16_t checksum;
} __attribute__((packed));

struct GetInfoResponse {
  uint8_t msgType1;
  uint8_t msgType2;
  uint16_t length;
  uint8_t opCode1;
  uint8_t opCode2;
  uint8_t responseCode;
  uint8_t version[2];
  uint16_t vendorId;
  uint16_t deviceType;
  uint8_t deviceRevision[2];
  uint8_t capability[4];
  uint8_t reserved;
  uint8_t modelNumber[16];
  uint8_t serialNumber[16];
  uint8_t firmwareYear20xx;
  uint8_t firmwareMonth;
  uint8_t firmwareDay;
  uint8_t firmwareMajor;
  uint8_t firmwareMinor;
  uint16_t checksum;
} __attribute__((packed));

struct GetUTCTimeResponse {
  uint8_t msgType1;
  uint8_t msgType2;
  uint16_t length;
  uint8_t opCode1;
  uint8_t opCode2;
  uint8_t responseCode;
  uint16_t utcSeconds;
  uint8_t timezoneOffsetQuarterHours;
  uint8_t dstOffsetQuarterHours;
  uint16_t checksum;
} __attribute__((packed));

struct CommodityData {
  uint8_t commodityCode;
  uint8_t instantRate[6];
  uint8_t cumlativeAmount[6];
} __attribute__((packed));

struct CommodityResponse {
  uint8_t msgType1;
  uint8_t msgType2;
  uint16_t length;
  uint8_t opCode1;
  uint8_t opCode2;
  uint8_t responseCode;
  struct CommodityData commodityData[7];
  uint16_t checksum;
} __attribute__((packed));

struct SetTemperatureOffsetRequest {
  uint8_t msgType1;
  uint8_t msgType2;
  uint16_t length;
  uint8_t opCode1;
  uint8_t opCode2;
  uint8_t currentOffset;
  uint8_t units;
  uint8_t forBasicDRCode;
  uint16_t checksum;
} __attribute__((packed));

struct GetTemperatureOffsetResponse {
  uint8_t msgType1;
  uint8_t msgType2;
  uint16_t length;
  uint8_t opCode1;
  uint8_t opCode2;
  uint8_t responseCode;
  uint8_t currentOffset;
  uint8_t units;
  uint8_t forBasicDRCode;
  uint16_t checksum;
} __attribute__((packed));

typedef enum {
  LLN_NO_REASON,
  LLN_INVALID_BYTE,
  LLN_INVALID_LENGTH,
  LLN_CHECKSUM_ERROR,
  LLN_RESERVED,
  LLN_MESSAGE_TIMEOUT,
  LLN_UNSUPPORTED_MESSAGE_TYPE,
  LLN_REQUEST_NOT_SUPPORTED,
  LLN_NONE
} LinkLayerNakCode;

typedef enum {
  DLT_INVALID,
  DLT_MAX_PAYLOAD_REQUEST = 0x18,
  DLT_MAX_PAYLOAD_RESPONSE = 0x19,
  DLT_SEND_NEXT_COMMAND_TO_SLOT = 0x1e
} DataLinkTypeCode;

typedef enum {
  IT_INVALID,
  IT_INFO_REQUEST = 0x0101,
  IT_INFO_RESPONSE = 0x0181,
  IT_GET_UTC_TIME_REQUEST = 0x0200,
  IT_COMMODITY_REQUEST = 0x0600,
  IT_COMMODITY_RESPONSE = 0x0680,
  IT_SET_ENERGY_PRICE_RESPONSE = 0x0380,
  IT_GET_SET_TEMPERATURE_OFFSET_REQUEST = 0x0302,
  IT_GET_SET_TEMPERATURE_OFFSET_RESPONSE = 0x0382,
  IT_GET_SET_SETPOINT_RESPONSE = 0x0383,
  IT_GET_PRESENT_TEMPERATURE_RESPONSE = 0X0384,
  IT_START_CYCLING_RESPONSE = 0x0480,
  IT_TERMINATE_CYCLING_RESPONSE = 0x0481
} IntermediateTypeCode;

#endif /* CTA2045_TYPES_H */
```

## src/cta2045_uart.c
```c
#include "cta2045_uart.h"
#include "common.h"
#include "cta2045_pack.h"
#include "cta2045_resp.h"
#include "cta2045_types.h"

#include <stddef.h>
#include <stdint.h>
#include <string.h>
#include <zephyr/device.h>
#include <zephyr/devicetree.h>
#include <zephyr/drivers/uart.h>
#include <zephyr/kernel.h>
#include <zephyr/logging/log.h>
#include <zephyr/sys/byteorder.h>
#include <zephyr/sys/ring_buffer.h>

#define CTA_MAX_PAYLOAD 256u
#define CTA_HDR_ONLY_SIZE 2u
#define CTA_LEN_SIZE 2u // BE payload length on-wire
#define CTA_CSUM_SIZE 2u
#define CTA_MIN_FRAME (CTA_HDR_ONLY_SIZE + CTA_LEN_SIZE + CTA_CSUM_SIZE) // 6
#define CTA_RX_BUF_SZ 512u // fits 4096 payload + header/len/csum, with margin

// Offsets relative to start of a frame (MessageHeader*)
#define CTA_OFF_LEN (CTA_HDR_ONLY_SIZE)                    // 2..3
#define CTA_OFF_PAYLOAD (CTA_HDR_ONLY_SIZE + CTA_LEN_SIZE) // 4..(4+len-1)

LOG_MODULE_REGISTER(cta2045_uart, LOG_LEVEL_INF);

/* UART device (adjust DT node label as needed) */
static const struct device *uart_dev = DEVICE_DT_GET(DT_NODELABEL(uart1));

/* Ring buffers */
static uint8_t rx_ring_buf_data[RING_BUF_SIZE];
static struct ring_buf rx_rb;

static uint8_t tx_ring_buf_data[TX_RING_BUF_SIZE];
static struct ring_buf tx_rb;

uint8_t rx_assemble_buf[CTA_RX_BUF_SZ];
size_t rx_assemble_len = 0;

static inline bool is_ll_ack(const struct MessageHeader *h) {
  return h->msgType1 == LL_ACK_MSG_TYP1 && h->msgType2 == LL_ACK_MSG_TYP2;
}
static inline bool is_ll_nak(const struct MessageHeader *h) {
  return h->msgType1 == LL_NAK_MSG_TYP1;
}
/* Simple RX semaphore (signal from ISR) */
K_SEM_DEFINE(uart_sem, 0, 1);

/* -------- TX queue -------- */
int send_response(const uint8_t *data, size_t len) {
  if (!uart_dev || !device_is_ready(uart_dev))
    return -ENODEV;
  if (!data || !len)
    return -EINVAL;

  unsigned int key = irq_lock();
  uint32_t put = ring_buf_put(&tx_rb, data, len);
  irq_unlock(key);

  if (put == 0)
    return -ENOBUFS;
  if (put < len) {
    /* best-effort; enable TX anyway */
  }
  uart_irq_tx_enable(uart_dev);
  return 0;
}

/* -------- ISR -------- */
static void uart_isr(const struct device *dev, void *user_data) {
  ARG_UNUSED(user_data);
  if (!uart_irq_update(dev))
    return;

  while (uart_irq_rx_ready(dev)) {
    uint8_t rx_buf[32];
    int rd = uart_fifo_read(dev, rx_buf, sizeof(rx_buf));
    if (rd <= 0)
      break;
    uint32_t wrote = ring_buf_put(&rx_rb, rx_buf, rd);
    if (wrote > 0)
      k_sem_give(&uart_sem);
  }

  while (uart_irq_tx_ready(dev)) {
    uint8_t tx_buf[32];
    uint32_t n = ring_buf_get(&tx_rb, tx_buf, sizeof(tx_buf));
    if (n == 0) {
      uart_irq_tx_disable(dev);
      break;
    }
    (void)uart_fifo_fill(dev, tx_buf, n);
  }
}

/* -------- Init & thread -------- */
int cta2045_uart_init(void) {
  if (!device_is_ready(uart_dev)) {
    LOG_ERR("UART device not ready");
    return -ENODEV;
  }

  ring_buf_init(&rx_rb, sizeof(rx_ring_buf_data), rx_ring_buf_data);
  ring_buf_init(&tx_rb, sizeof(tx_ring_buf_data), tx_ring_buf_data);

  struct uart_config cfg = {
      .baudrate = 115200,
      .parity = UART_CFG_PARITY_NONE,
      .stop_bits = UART_CFG_STOP_BITS_1,
      .data_bits = UART_CFG_DATA_BITS_8,
      .flow_ctrl = UART_CFG_FLOW_CTRL_NONE,
  };
  (void)uart_configure(uart_dev, &cfg);

  uart_irq_callback_set(uart_dev, uart_isr);
  uart_irq_rx_enable(uart_dev);
  return 0;
}

void cta2045_init(void) { /* reserved for future state */ }

void cta2045_uart_thread(void *p1, void *p2, void *p3) {
  ARG_UNUSED(p1);
  ARG_UNUSED(p2);
  ARG_UNUSED(p3);

  for (;;) {
    k_sem_take(&uart_sem, K_FOREVER);

    uint8_t chunk[64];
    size_t bytes_read;
    while ((bytes_read = ring_buf_get(&rx_rb, chunk, sizeof(chunk))) != 0) {
      LOG_HEXDUMP_DBG(chunk, bytes_read, "RX chunk");

      // Ensure assembler has room
      if (bytes_read > (CTA_RX_BUF_SZ - rx_assemble_len)) {
        size_t need = bytes_read - (CTA_RX_BUF_SZ - rx_assemble_len);
        if (need > rx_assemble_len)
          need = rx_assemble_len;
        if (need) {
          memmove(rx_assemble_buf, rx_assemble_buf + need,
                  rx_assemble_len - need);
          rx_assemble_len -= need;
          LOG_WRN("CTA2045: assembler overflow, dropped %zu byte(s)", need);
        }
      }

      // Append new data
      memcpy(rx_assemble_buf + rx_assemble_len, chunk, bytes_read);
      rx_assemble_len += bytes_read;

      for (;;) {

        // --- Fast-path: header-only LL frames (2 bytes total) ---

        if (rx_assemble_len >= 2) {
          struct MessageHeader *h2 = (struct MessageHeader *)rx_assemble_buf;
          if (is_ll_ack(h2)) {
            LOG_INF("LL-ACK (header-only) received");
            // TODO: k_sem_give(&ll_ack_sem); // if you track TX acks
            // consume 2 bytes
            if (2 < rx_assemble_len) {
              memmove(rx_assemble_buf, rx_assemble_buf + 2,
                      rx_assemble_len - 2);
            }
            rx_assemble_len -= 2;
            continue; // check if another frame is ready
          }
          if (is_ll_nak(h2)) {
            LOG_INF("LL-NAK (header-only) received");
            // TODO: record NAK, trigger retry/backoff, etc.
            if (2 < rx_assemble_len) {
              memmove(rx_assemble_buf, rx_assemble_buf + 2,
                      rx_assemble_len - 2);
            }
            rx_assemble_len -= 2;
            continue;
          }
        }

        // --- Normal path: full frames need hdr+len+csum (>= 6 bytes) ---
        if (rx_assemble_len < CTA_MIN_FRAME)
          break;

        // (unchanged) read length at offset +2, sanity, checksum, etc...
        uint16_t payload_len = sys_get_be16(rx_assemble_buf + CTA_OFF_LEN);
        if ((payload_len > CTA_MAX_PAYLOAD) ||
            (payload_len > (CTA_RX_BUF_SZ - CTA_MIN_FRAME))) {
          memmove(rx_assemble_buf, rx_assemble_buf + 1, rx_assemble_len - 1);
          rx_assemble_len -= 1;
          LOG_WRN("CTA2045: bad length %u, resync by 1 byte", payload_len);
          continue;
        }

        size_t total_len =
            CTA_HDR_ONLY_SIZE + CTA_LEN_SIZE + payload_len + CTA_CSUM_SIZE;
        if (rx_assemble_len < total_len)
          break;

        uint16_t calc =
            checksum_calc(rx_assemble_buf, total_len - CTA_CSUM_SIZE);
        uint16_t got =
            sys_get_be16(rx_assemble_buf + (total_len - CTA_CSUM_SIZE));
        if (calc != got) {
          LOG_WRN(
              "CTA2045: checksum mismatch (calc=0x%04x got=0x%04x) — resync",
              calc, got);
          memmove(rx_assemble_buf, rx_assemble_buf + 1, rx_assemble_len - 1);
          rx_assemble_len -= 1;
          continue;
        }

        struct MessageHeader *hdr = (struct MessageHeader *)rx_assemble_buf;
        process_response(hdr);

        // consume full frame
        if (total_len < rx_assemble_len) {
          memmove(rx_assemble_buf, rx_assemble_buf + total_len,
                  rx_assemble_len - total_len);
        }
        rx_assemble_len -= total_len;
      }
    }
  }
}
```

## src/cta2045_uart.h
```c
#ifndef CTA2045_UART_H
#define CTA2045_UART_H

#include "common.h"
#include "cta2045_types.h"
#include <stddef.h>
#include <stdint.h>

/* Init UART/rings and RX worker */
void cta2045_init(void);
int cta2045_uart_init(void);
void cta2045_uart_thread(void *p1, void *p2, void *p3);

/* Non-blocking TX (queues to ISR) */
int send_response(const uint8_t *response, size_t len);

#endif /* CTA2045_UART_H */
```
