## echoes/build/Kconfig/arch/Kconfig
```kconfig
# Load Zephyr Arch Kconfig descriptions.
osource "/home/powerlab/app/zephyr/arch/rx/Kconfig"
osource "/home/powerlab/app/zephyr/arch/x86/Kconfig"
osource "/home/powerlab/app/zephyr/arch/xtensa/Kconfig"
osource "/home/powerlab/app/zephyr/arch/sparc/Kconfig"
osource "/home/powerlab/app/zephyr/arch/riscv/Kconfig"
osource "/home/powerlab/app/zephyr/arch/posix/Kconfig"
osource "/home/powerlab/app/zephyr/arch/mips/Kconfig"
osource "/home/powerlab/app/zephyr/arch/arm64/Kconfig"
osource "/home/powerlab/app/zephyr/arch/arm/Kconfig"
osource "/home/powerlab/app/zephyr/arch/arc/Kconfig"
```

## echoes/build/Kconfig/boards/Kconfig
```kconfig
# Load Zephyr board Kconfig descriptions.
osource "/home/powerlab/app/zephyr/boards/nordic/nrf9161dk/Kconfig"
config BOARD_REVISION_0_9_0
	def_bool y
```

## echoes/build/Kconfig/boards/Kconfig.defconfig
```kconfig
# Load Zephyr board defconfig descriptions.
osource "/home/powerlab/app/zephyr/boards/nordic/nrf9161dk/Kconfig.defconfig"
```

## echoes/build/Kconfig/boards/Kconfig.nrf9161dk
```kconfig
# Load board Kconfig descriptions.
osource "/home/powerlab/app/zephyr/boards/nordic/nrf9161dk/Kconfig.nrf9161dk"
```

## echoes/build/Kconfig/boards/Kconfig.sysbuild
```kconfig
# Load Sysbuild board Kconfig descriptions.
osource "/home/powerlab/app/zephyr/boards/nordic/nrf9161dk/Kconfig.sysbuild"
```

## echoes/build/Kconfig/soc/Kconfig
```kconfig
# Load Zephyr SoC Kconfig descriptions.
osource "/home/powerlab/app/zephyr/soc/xlnx/zynqmp/Kconfig"
osource "/home/powerlab/app/zephyr/soc/xlnx/zynq7000/Kconfig"
osource "/home/powerlab/app/zephyr/soc/xlnx/versalnet/Kconfig"
osource "/home/powerlab/app/zephyr/soc/xlnx/versal2/Kconfig"
osource "/home/powerlab/app/zephyr/soc/xen/Kconfig"
osource "/home/powerlab/app/zephyr/soc/wch/ch32v/Kconfig"
osource "/home/powerlab/app/zephyr/soc/ti/simplelink/Kconfig"
osource "/home/powerlab/app/zephyr/soc/ti/mspm0/Kconfig"
osource "/home/powerlab/app/zephyr/soc/ti/lm3s6965/Kconfig"
osource "/home/powerlab/app/zephyr/soc/ti/k3/Kconfig"
osource "/home/powerlab/app/zephyr/soc/telink/tlsr/Kconfig"
osource "/home/powerlab/app/zephyr/soc/starfive/jh71xx/Kconfig"
osource "/home/powerlab/app/zephyr/soc/st/stm32/Kconfig"
osource "/home/powerlab/app/zephyr/soc/snps/qemu_arc/Kconfig"
osource "/home/powerlab/app/zephyr/soc/snps/nsim/arc_v/Kconfig"
osource "/home/powerlab/app/zephyr/soc/snps/nsim/arc_classic/Kconfig"
osource "/home/powerlab/app/zephyr/soc/snps/hsdk4xd/Kconfig"
osource "/home/powerlab/app/zephyr/soc/snps/hsdk/Kconfig"
osource "/home/powerlab/app/zephyr/soc/snps/emsk/Kconfig"
osource "/home/powerlab/app/zephyr/soc/snps/emsdp/Kconfig"
osource "/home/powerlab/app/zephyr/soc/snps/arc_iot/Kconfig"
osource "/home/powerlab/app/zephyr/soc/silabs/Kconfig"
osource "/home/powerlab/app/zephyr/soc/sifive/sifive_freedom/Kconfig"
osource "/home/powerlab/app/zephyr/soc/sensry/Kconfig"
osource "/home/powerlab/app/zephyr/soc/rockchip/Kconfig"
osource "/home/powerlab/app/zephyr/soc/renode/riscv_virtual/Kconfig"
osource "/home/powerlab/app/zephyr/soc/renode/cortex_r8_virtual/Kconfig"
osource "/home/powerlab/app/zephyr/soc/renesas/smartbond/Kconfig"
osource "/home/powerlab/app/zephyr/soc/renesas/rz/Kconfig"
osource "/home/powerlab/app/zephyr/soc/renesas/rx/Kconfig"
osource "/home/powerlab/app/zephyr/soc/renesas/rcar/Kconfig"
osource "/home/powerlab/app/zephyr/soc/renesas/ra/Kconfig"
osource "/home/powerlab/app/zephyr/soc/realtek/ec/Kconfig"
osource "/home/powerlab/app/zephyr/soc/raspberrypi/rpi_pico/Kconfig"
osource "/home/powerlab/app/zephyr/soc/quicklogic/eos_s3/Kconfig"
osource "/home/powerlab/app/zephyr/soc/qemu/virt_riscv/Kconfig"
osource "/home/powerlab/app/zephyr/soc/qemu/malta/Kconfig"
osource "/home/powerlab/app/zephyr/soc/openisa/rv32m1/Kconfig"
osource "/home/powerlab/app/zephyr/soc/openhwgroup/cva6/Kconfig"
osource "/home/powerlab/app/zephyr/soc/oct/osd32mp15x/Kconfig"
osource "/home/powerlab/app/zephyr/soc/nxp/s32/Kconfig"
osource "/home/powerlab/app/zephyr/soc/nxp/rw/Kconfig"
osource "/home/powerlab/app/zephyr/soc/nxp/mcx/Kconfig"
osource "/home/powerlab/app/zephyr/soc/nxp/lpc/Kconfig"
osource "/home/powerlab/app/zephyr/soc/nxp/layerscape/Kconfig"
osource "/home/powerlab/app/zephyr/soc/nxp/kinetis/Kconfig"
osource "/home/powerlab/app/zephyr/soc/nxp/imxrt/Kconfig"
osource "/home/powerlab/app/zephyr/soc/nxp/imx/Kconfig"
osource "/home/powerlab/app/zephyr/soc/nuvoton/numicro/Kconfig"
osource "/home/powerlab/app/zephyr/soc/nuvoton/numaker/Kconfig"
osource "/home/powerlab/app/zephyr/soc/nuvoton/npcx/Kconfig"
osource "/home/powerlab/app/zephyr/soc/nuvoton/npcm/Kconfig"
osource "/home/powerlab/app/zephyr/soc/nordic/Kconfig"
osource "/home/powerlab/app/zephyr/soc/neorv32/Kconfig"
osource "/home/powerlab/app/zephyr/soc/native/inf_clock/Kconfig"
osource "/home/powerlab/app/zephyr/soc/microchip/sam/Kconfig"
osource "/home/powerlab/app/zephyr/soc/microchip/miv/Kconfig"
osource "/home/powerlab/app/zephyr/soc/microchip/mec/Kconfig"
osource "/home/powerlab/app/zephyr/soc/mediatek/mt8xxx/Kconfig"
osource "/home/powerlab/app/zephyr/soc/lowrisc/opentitan/Kconfig"
osource "/home/powerlab/app/zephyr/soc/litex/litex_vexriscv/Kconfig"
osource "/home/powerlab/app/zephyr/soc/ite/ec/Kconfig"
osource "/home/powerlab/app/zephyr/soc/intel/raptor_lake/Kconfig"
osource "/home/powerlab/app/zephyr/soc/intel/lakemont/Kconfig"
osource "/home/powerlab/app/zephyr/soc/intel/intel_socfpga_std/Kconfig"
osource "/home/powerlab/app/zephyr/soc/intel/intel_socfpga/Kconfig"
osource "/home/powerlab/app/zephyr/soc/intel/intel_niosv/Kconfig"
osource "/home/powerlab/app/zephyr/soc/intel/intel_ish/Kconfig"
osource "/home/powerlab/app/zephyr/soc/intel/intel_adsp/Kconfig"
osource "/home/powerlab/app/zephyr/soc/intel/elkhart_lake/Kconfig"
osource "/home/powerlab/app/zephyr/soc/intel/atom/Kconfig"
osource "/home/powerlab/app/zephyr/soc/intel/apollo_lake/Kconfig"
osource "/home/powerlab/app/zephyr/soc/intel/alder_lake/Kconfig"
osource "/home/powerlab/app/zephyr/soc/infineon/cat3/Kconfig"
osource "/home/powerlab/app/zephyr/soc/infineon/cat1c/Kconfig"
osource "/home/powerlab/app/zephyr/soc/infineon/cat1b/Kconfig"
osource "/home/powerlab/app/zephyr/soc/infineon/cat1a/Kconfig"
osource "/home/powerlab/app/zephyr/soc/gd/gd32/Kconfig"
osource "/home/powerlab/app/zephyr/soc/gaisler/leon3/Kconfig"
osource "/home/powerlab/app/zephyr/soc/gaisler/gr716a/Kconfig"
osource "/home/powerlab/app/zephyr/soc/espressif/Kconfig"
osource "/home/powerlab/app/zephyr/soc/ene/kb1200/Kconfig"
osource "/home/powerlab/app/zephyr/soc/ene/kb106x/Kconfig"
osource "/home/powerlab/app/zephyr/soc/efinix/sapphire/Kconfig"
osource "/home/powerlab/app/zephyr/soc/cdns/xtensa_sample_controller/Kconfig"
osource "/home/powerlab/app/zephyr/soc/cdns/sample_controller32/Kconfig"
osource "/home/powerlab/app/zephyr/soc/cdns/dc233c/Kconfig"
osource "/home/powerlab/app/zephyr/soc/brcm/bcmvk/Kconfig"
osource "/home/powerlab/app/zephyr/soc/brcm/bcm2712/Kconfig"
osource "/home/powerlab/app/zephyr/soc/brcm/bcm2711/Kconfig"
osource "/home/powerlab/app/zephyr/soc/bflb/Kconfig"
osource "/home/powerlab/app/zephyr/soc/atmel/sam0/Kconfig"
osource "/home/powerlab/app/zephyr/soc/atmel/sam/Kconfig"
osource "/home/powerlab/app/zephyr/soc/aspeed/Kconfig"
osource "/home/powerlab/app/zephyr/soc/arm/Kconfig"
osource "/home/powerlab/app/zephyr/soc/arm/beetle/Kconfig"
osource "/home/powerlab/app/zephyr/soc/antmicro/myra/Kconfig"
osource "/home/powerlab/app/zephyr/soc/andestech/Kconfig"
osource "/home/powerlab/app/zephyr/soc/amd/acp_6_0/Kconfig"
osource "/home/powerlab/app/zephyr/soc/ambiq/Kconfig"
osource "/home/powerlab/app/zephyr/soc/aesc/Kconfig"
osource "/home/powerlab/app/zephyr/soc/adi/max32/Kconfig"
```
